#include <physical_layouts.dtsi>

/ {
    physical_layout0: physical_layout_0 {
        compatible = "zmk,physical-layout";
        display-name = "Mon Clavier Split 110mAh";
        transform = <&matrix_transform0>;

        keys {
            /* --- RANGÉE 0 (LIGNE CORRESPONDANTE À ROW0) --- */
            &key_physical_attrs { width = <100>; height = <100>; x = <0>; y = <0>; }; // Esc
            &key_physical_attrs { width = <100>; height = <100>; x = <100>; y = <0>; }; // 1
            &key_physical_attrs { width = <100>; height = <100>; x = <200>; y = <0>; }; // 2
            &key_physical_attrs { width = <100>; height = <100>; x = <300>; y = <0>; }; // 3
            &key_physical_attrs { width = <100>; height = <100>; x = <400>; y = <0>; }; // 4
            &key_physical_attrs { width = <100>; height = <100>; x = <500>; y = <0>; }; // 5
            &key_physical_attrs { width = <100>; height = <100>; x = <600>; y = <0>; }; // 6
            &key_physical_attrs { width = <100>; height = <100>; x = <700>; y = <0>; }; // 7
            &key_physical_attrs { width = <100>; height = <100>; x = <800>; y = <0>; }; // 8
            &key_physical_attrs { width = <100>; height = <100>; x = <900>; y = <0>; }; // 9
            &key_physical_attrs { width = <100>; height = <100>; x = <1000>; y = <0>; }; // 0
            &key_physical_attrs { width = <100>; height = <100>; x = <1100>; y = <0>; }; // -
            &key_physical_attrs { width = <100>; height = <100>; x = <1200>; y = <0>; }; // =
            &key_physical_attrs { width = <200>; height = <100>; x = <1300>; y = <0>; }; // Backspace

            /* --- RANGÉE 1 (LIGNE CORRESPONDANTE À ROW1) --- */
            &key_physical_attrs { width = <150>; height = <100>; x = <0>; y = <100>; }; // Tab
            &key_physical_attrs { width = <100>; height = <100>; x = <150>; y = <100>; }; // A
            &key_physical_attrs { width = <100>; height = <100>; x = <250>; y = <100>; }; // Z
            &key_physical_attrs { width = <100>; height = <100>; x = <350>; y = <100>; }; // E
            &key_physical_attrs { width = <100>; height = <100>; x = <450>; y = <100>; }; // R
            &key_physical_attrs { width = <100>; height = <100>; x = <550>; y = <100>; }; // T
            &key_physical_attrs { width = <100>; height = <100>; x = <650>; y = <100>; }; // Y
            &key_physical_attrs { width = <100>; height = <100>; x = <750>; y = <100>; }; // U
            &key_physical_attrs { width = <100>; height = <100>; x = <850>; y = <100>; }; // I
            &key_physical_attrs { width = <100>; height = <100>; x = <950>; y = <100>; }; // O
            &key_physical_attrs { width = <100>; height = <100>; x = <1050>; y = <100>; }; // P
            &key_physical_attrs { width = <100>; height = <100>; x = <1150>; y = <100>; }; // [
            &key_physical_attrs { width = <100>; height = <100>; x = <1250>; y = <100>; }; // ]
            &key_physical_attrs { width = <150>; height = <100>; x = <1350>; y = <100>; }; // Enter (Top part)

            /* --- RANGÉE 2 (LIGNE CORRESPONDANTE À ROW2) --- */
            &key_physical_attrs { width = <175>; height = <100>; x = <0>; y = <200>; }; // Caps Lock
            &key_physical_attrs { width = <100>; height = <100>; x = <175>; y = <200>; }; // Q
            &key_physical_attrs { width = <100>; height = <100>; x = <275>; y = <200>; }; // S
            &key_physical_attrs { width = <100>; height = <100>; x = <375>; y = <200>; }; // D
            &key_physical_attrs { width = <100>; height = <100>; x = <475>; y = <200>; }; // F
            &key_physical_attrs { width = <100>; height = <100>; x = <575>; y = <200>; }; // G
            &key_physical_attrs { width = <100>; height = <100>; x = <675>; y = <200>; }; // H
            &key_physical_attrs { width = <100>; height = <100>; x = <775>; y = <200>; }; // J
            &key_physical_attrs { width = <100>; height = <100>; x = <875>; y = <200>; }; // K
            &key_physical_attrs { width = <100>; height = <100>; x = <975>; y = <200>; }; // L
            &key_physical_attrs { width = <100>; height = <100>; x = <1075>; y = <200>; }; // M / :
            &key_physical_attrs { width = <100>; height = <100>; x = <1175>; y = <200>; }; // ^
            &key_physical_attrs { width = <100>; height = <100>; x = <1275>; y = <200>; }; // # / ~

            /* --- RANGÉE 3 (LIGNE CORRESPONDANTE À ROW3) --- */
            &key_physical_attrs { width = <125>; height = <100>; x = <0>; y = <300>; }; // Shift L
            &key_physical_attrs { width = <100>; height = <100>; x = <125>; y = <300>; }; // <
            &key_physical_attrs { width = <100>; height = <100>; x = <225>; y = <300>; }; // W
            &key_physical_attrs { width = <100>; height = <100>; x = <325>; y = <300>; }; // X
            &key_physical_attrs { width = <100>; height = <100>; x = <425>; y = <300>; }; // C
            &key_physical_attrs { width = <100>; height = <100>; x = <525>; y = <300>; }; // V
            &key_physical_attrs { width = <100>; height = <100>; x = <625>; y = <300>; }; // B
            &key_physical_attrs { width = <100>; height = <100>; x = <725>; y = <300>; }; // N
            &key_physical_attrs { width = <100>; height = <100>; x = <825>; y = <300>; }; // M
            &key_physical_attrs { width = <100>; height = <100>; x = <925>; y = <300>; }; // ,
            &key_physical_attrs { width = <100>; height = <100>; x = <1025>; y = <300>; }; // .
            &key_physical_attrs { width = <100>; height = <100>; x = <1125>; y = <300>; }; // /
            &key_physical_attrs { width = <275>; height = <100>; x = <1225>; y = <300>; }; // Shift R

            /* --- RANGÉE 4 (LIGNE CORRESPONDANTE À ROW4) --- */
            &key_physical_attrs { width = <150>; height = <100>; x = <0>; y = <400>; }; // Ctrl L
            &key_physical_attrs { width = <100>; height = <100>; x = <150>; y = <400>; }; // Win L
            &key_physical_attrs { width = <125>; height = <100>; x = <250>; y = <400>; }; // Alt L
            &key_physical_attrs { width = <225>; height = <100>; x = <375>; y = <400>; }; // Space L
            &key_physical_attrs { width = <400>; height = <100>; x = <600>; y = <400>; }; // Space R
            &key_physical_attrs { width = <125>; height = <100>; x = <1000>; y = <400>; }; // Alt Gr
            &key_physical_attrs { width = <125>; height = <100>; x = <1125>; y = <400>; }; // Win R
            &key_physical_attrs { width = <125>; height = <100>; x = <1250>; y = <400>; }; // FN / Menu (Vide)
            &key_physical_attrs { width = <125>; height = <100>; x = <1375>; y = <400>; }; // Studio Unlock (Ctrl R)
        };
    };
};
