## boards/shields/mon_clavier/Kconfig.defconfig
```kconfig
if SHIELD_MON_CLAVIER_LEFT || SHIELD_MON_CLAVIER_RIGHT

config ZMK_KEYBOARD_NAME
    default "Mon Clavier"

endif
```

## boards/shields/mon_clavier/Kconfig.shield
```kconfig
config SHIELD_MON_CLAVIER_LEFT
    def_bool $(shields_list_contains,mon_clavier_left)

config SHIELD_MON_CLAVIER_RIGHT
    def_bool $(shields_list_contains,mon_clavier_right)
```
