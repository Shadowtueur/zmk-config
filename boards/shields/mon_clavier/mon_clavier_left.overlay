#include "mon_clavier.dtsi"

/ {
    chosen {
        zmk,kscan = &kscan0;
        zmk,matrix-transform = &matrix_transform0;
        
        /* AJOUTE CETTE LIGNE ICI POUR ZMK STUDIO */
        zmk,physical-layout = &physical_layout0;
    };

    kscan0: kscan_0 {
        compatible = "zmk,kscan-gpio-matrix";
        label = "KSCAN";
        diode-direction = "col2row";

        row-gpios
            = <&gpio0 22 (GPIO_ACTIVE_HIGH | GPIO_PULL_DOWN)> /* ROW0 */
            , <&gpio1  0 (GPIO_ACTIVE_HIGH | GPIO_PULL_DOWN)> /* ROW1 */
            , <&gpio1  7 (GPIO_ACTIVE_HIGH | GPIO_PULL_DOWN)> /* ROW2 */
            , <&gpio1 11 (GPIO_ACTIVE_HIGH | GPIO_PULL_DOWN)> /* ROW3 */
            , <&gpio1 13 (GPIO_ACTIVE_HIGH | GPIO_PULL_DOWN)> /* ROW4 */
            ;

        col-gpios
            = <&gpio0 17 GPIO_ACTIVE_HIGH> /* COL0 */
            , <&gpio0 11 GPIO_ACTIVE_HIGH> /* COL1 */
            , <&gpio0 10 GPIO_ACTIVE_HIGH> /* COL2 */
            , <&gpio0  9 GPIO_ACTIVE_HIGH> /* COL3 */
            , <&gpio1  4 GPIO_ACTIVE_HIGH> /* COL4 */
            , <&gpio1  6 GPIO_ACTIVE_HIGH> /* COL5 */
            ;
    };
};
